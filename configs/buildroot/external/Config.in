## configs/buildroot/external/package/hello_riscv/Config.in
```kconfig
config BR2_PACKAGE_HELLO_RISCV
    bool "hello_riscv"
    help
      A simple Hello World program for RISC-V verification.
```

## configs/buildroot/qemu_riscv64_minimal.defconfig
```kconfig
# Buildroot minimal configuration for RISC-V QEMU
# Rootfs only - kernel is built separately

# Target architecture
BR2_riscv=y
BR2_RISCV_64=y
BR2_RISCV_ABI_LP64D=y
BR2_RISCV_ISA_RVC=y

# Toolchain - use external (host cross-compiler)
BR2_TOOLCHAIN_EXTERNAL=y
BR2_TOOLCHAIN_EXTERNAL_CUSTOM=y
BR2_TOOLCHAIN_EXTERNAL_PATH="/usr"
BR2_TOOLCHAIN_EXTERNAL_PREFIX="riscv64-linux-gnu"
BR2_TOOLCHAIN_EXTERNAL_GCC_13=y
BR2_TOOLCHAIN_EXTERNAL_HEADERS_6_5=y
BR2_TOOLCHAIN_EXTERNAL_CUSTOM_GLIBC=y
BR2_TOOLCHAIN_EXTERNAL_CXX=y

# System configuration
BR2_TARGET_GENERIC_HOSTNAME="buildroot"
BR2_TARGET_GENERIC_ISSUE="Welcome to Buildroot"
BR2_TARGET_GENERIC_ROOT_PASSWD=""
BR2_SYSTEM_DHCP="eth0"

# Init system - busybox init
BR2_INIT_BUSYBOX=y

# Root filesystem
BR2_TARGET_ROOTFS_CPIO=y
BR2_TARGET_ROOTFS_CPIO_GZIP=y

# No kernel (built separately)
BR2_LINUX_KERNEL=n

# Minimal packages
BR2_PACKAGE_BUSYBOX=y
BR2_PACKAGE_BUSYBOX_SHOW_OTHERS=y
BR2_PACKAGE_IPROUTE2=y
BR2_PACKAGE_LIBBPF=y
BR2_PACKAGE_BPFTOOL=y
BR2_PACKAGE_BINUTILS_TARGET=y
```
